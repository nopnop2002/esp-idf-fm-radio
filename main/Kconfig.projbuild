## main/Kconfig.projbuild
```kconfig
menu "Application configuration"

	menu "WiFi Setting"

	config ESP_WIFI_SSID
		string "WiFi SSID"
		default "myssid"
		help
			SSID (network name) to connect to.

	config ESP_WIFI_PASSWORD
		string "WiFi Password"
		default "mypassword"
		help
			WiFi password (WPA or WPA2) to connect to.

	config ESP_MAXIMUM_RETRY
		int "Maximum retry"
		default 5
		help
			Set the Maximum retry to avoid station reconnecting to the AP unlimited when the AP is really inexistent.

	config MDNS_HOSTNAME
		string "mDNS Hostname"
		default "esp32-server"
		help
			The mDNS host name used by the ESP32.

	config STATIC_IP
		bool "Enable Static IP Address"
		default false
		help
			Enable Static IP Address.

	config STATIC_IP_ADDRESS
		depends on STATIC_IP
		string "Static IP Address"
		default "192.168.10.100"
		help
			Static IP Address for Station.

	config STATIC_GW_ADDRESS
		depends on STATIC_IP
		string "Static GW Address"
		default "192.168.10.1"
		help
			Static GW Address for Station.

	config STATIC_NM_ADDRESS
		depends on STATIC_IP
		string "Static Netmask"
		default "255.255.255.0"
		help
			Static Netmask for Station.

	endmenu

	menu "TEA5767 Setting"

		config GPIO_RANGE_MAX
			int
			default 33 if IDF_TARGET_ESP32
			default 46 if IDF_TARGET_ESP32S2
			default 19 if IDF_TARGET_ESP32C3
			default 48 if IDF_TARGET_ESP32S3

		config SCL_GPIO
			int "SCL GPIO number"
			range 0 GPIO_RANGE_MAX
			default 22 if IDF_TARGET_ESP32
			default 4  if IDF_TARGET_ESP32S2
			default 4  if IDF_TARGET_ESP32S3
			default 19 if IDF_TARGET_ESP32C3
			help
				GPIO number (IOxx) to I2C SCL.
				Some GPIOs are used for other purposes (flash connections, etc.) and cannot be used to I2C.
				GPIOs 35-39 are input-only so cannot be used as outputs.

		config SDA_GPIO
			int "SDA GPIO number"
			range 0 GPIO_RANGE_MAX
			default 21 if IDF_TARGET_ESP32
			default 3  if IDF_TARGET_ESP32S2
			default 3  if IDF_TARGET_ESP32S3
			default 18 if IDF_TARGET_ESP32C3
			help
				GPIO number (IOxx) to I2C SDA.
				Some GPIOs are used for other purposes (flash connections, etc.) and cannot be used to I2C.
				GPIOs 35-39 are input-only so cannot be used as outputs.

		choice FM_BAND
			bool "Select your location"
			default FM_BAND_US
			help
				Select your location.
			config FM_BAND_US
				bool "US/Europe (87.5 MHz to 108 MHz)"
			config FM_BAND_JP
				bool "Japan (76 MHz to 91 MHz)"
		endchoice

	endmenu

endmenu
```
